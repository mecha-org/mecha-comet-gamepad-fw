## app/src/status_led/Kconfig
```kconfig
# Copyright (c) 2026 Mecha Systems
# SPDX-License-Identifier: BSD-3-Clause

config COMET_GAMEPAD_STATUS_LED
	bool "Blink the status LED"
	default y
	depends on $(dt_nodelabel_enabled,status_led)
	help
	  Blink the status LED on the board while the firmware runs. Turn this off in a
	  release build: the case may hide the LED and the LED draws current.
```

## app/src/usb/Kconfig
```kconfig
# Copyright (c) 2026 Mecha Systems
# SPDX-License-Identifier: BSD-3-Clause

config COMET_GAMEPAD_USB_VID
	hex "USB vendor ID"
	default 0x1209
	help
	  The default is the vendor ID that pid.codes shares between open source hardware
	  projects. Replace it if Mecha gets a vendor ID of its own.

config COMET_GAMEPAD_USB_PID
	hex "USB product ID"
	default 0x0001
	help
	  The default is the pid.codes test product ID. Replace it with the product ID that
	  pid.codes allocates for the gamepad before shipping.

config COMET_GAMEPAD_USB_MANUFACTURER
	string "USB manufacturer string"
	default "Mecha Systems"
	help
	  Manufacturer name that the host shows, for example in the output of lsusb.

config COMET_GAMEPAD_USB_PRODUCT
	string "USB product string"
	default "Comet Gamepad Extension"
	help
	  Product name that the host shows, for example in the output of lsusb.

config COMET_GAMEPAD_USB_MAX_POWER
	int "USB maximum power draw in units of 2 mA"
	default 50
	range 0 250
	help
	  Current the gamepad tells the host it may draw from the USB bus. The default of 50
	  is 100 mA.
```

## boards/mecha/comet_gamepad/board.yml
```yaml
# Copyright (c) 2026 Mecha Systems
# SPDX-License-Identifier: BSD-3-Clause

board:
  name: mecha_comet_gamepad
  full_name: Mecha Comet Gamepad Extension
  vendor: mecha
  socs:
    - name: mcxc243
```

## boards/mecha/comet_gamepad/mecha_comet_gamepad_defconfig
```kconfig
# Copyright (c) 2026 Mecha Systems
# SPDX-License-Identifier: BSD-3-Clause

CONFIG_USE_DT_CODE_PARTITION=y
CONFIG_CONSOLE=y
CONFIG_UART_CONSOLE=y
CONFIG_SERIAL=y
CONFIG_GPIO=y
```

## west.yml
```yaml
# Copyright (c) 2026 Mecha Systems
# SPDX-License-Identifier: BSD-3-Clause

manifest:
  remotes:
    - name: zephyrproject-rtos
      url-base: https://github.com/zephyrproject-rtos
    - name: mecha-org
      url-base: https://github.com/mecha-org
  projects:
    - name: zephyr
      remote: zephyrproject-rtos
      revision: v4.5.0
      import:
        # Only the modules this firmware needs.
        name-allowlist:
          - cmsis_6
          - hal_nxp
    # Pinned to a commit until Pivot Pip has a release tag. Use the tag then.
    - name: mecha-pivot-pip
      remote: mecha-org
      repo-path: mecha-pivot-pip-zephyr
      revision: 1972e2e27f84f06e5477e9116dbefb7d55101b57
      path: modules/lib/mecha-pivot-pip
  self:
    path: mecha-comet-gamepad-fw
```
