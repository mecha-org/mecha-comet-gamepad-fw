## CMakeLists.txt
```
# Copyright (c) 2026 Mecha Systems
# SPDX-License-Identifier: BSD-3-Clause

cmake_minimum_required(VERSION 3.28.0)

# The build variants in snippets/ are used with `west build -S <name>`.
list(APPEND SNIPPET_ROOT ${CMAKE_CURRENT_SOURCE_DIR})

find_package(Zephyr REQUIRED HINTS $ENV{ZEPHYR_BASE})
project(comet_gamepad)

# Headers are included with their folder, for example "hid/gamepad_hid.h".
target_include_directories(app PRIVATE src)

target_sources(app PRIVATE src/main.c)

# One folder per part of the firmware. Optional parts are only built when their option is on.
add_subdirectory(src/gamepad)
add_subdirectory(src/hid)
add_subdirectory(src/usb)
add_subdirectory_ifdef(CONFIG_COMET_GAMEPAD_STATUS_LED src/status_led)
```

## Kconfig
```
# Copyright (c) 2026 Mecha Systems
# SPDX-License-Identifier: BSD-3-Clause

# Application Kconfig entry point. Browse options with `west build -t menuconfig`.
# Every part of the firmware that has options keeps them in a Kconfig file next to its source.

menu "Zephyr"
source "Kconfig.zephyr"
endmenu

rsource "src/usb/Kconfig"
rsource "src/status_led/Kconfig"

module = COMET_GAMEPAD
module-str = Comet Gamepad
source "subsys/logging/Kconfig.template.log_config"
```

## prj.conf
```kconfig
# Copyright (c) 2026 Mecha Systems
# SPDX-License-Identifier: BSD-3-Clause

CONFIG_LOG=y

# Buttons and sticks arrive as input events.
CONFIG_INPUT=y

# The USB serial number comes from the unique ID of the chip.
CONFIG_HWINFO=y

CONFIG_USB_DEVICE_STACK_NEXT=y
CONFIG_USBD_LOG_LEVEL_WRN=y
CONFIG_USBD_HID_LOG_LEVEL_WRN=y
CONFIG_UDC_DRIVER_LOG_LEVEL_WRN=y
```

## debug.conf
```kconfig
# Copyright (c) 2026 Mecha Systems
# SPDX-License-Identifier: BSD-3-Clause

# Logs every input event of the buttons and sticks on the UART. Use it with:
#   west build -b mecha_comet_gamepad mecha-comet-gamepad-fw/app -- -DEXTRA_CONF_FILE=debug.conf
CONFIG_INPUT_EVENT_DUMP=y
CONFIG_INPUT_QUEUE_MAX_MSGS=64
CONFIG_LOG_BUFFER_SIZE=4096
```

## app.overlay
```dts
/*
 * Copyright (c) 2026 Mecha Systems
 *
 * SPDX-License-Identifier: BSD-3-Clause
 */

/ {
	/* The HID gamepad. The report descriptor is in src/hid/gamepad_hid.c. */
	hid_gamepad: hid-gamepad {
		compatible = "zephyr,hid-device";
		label = "Mecha Comet Gamepad Extension";
		protocol-code = "none";
		/* Must be at least GAMEPAD_HID_REPORT_SIZE. */
		in-report-size = <11>;

		/*
		 * How often the host polls the gamepad. This also sets the fastest report rate, because a
		 * report is sent when the host has read the previous one.
		 */
		in-polling-period-us = <4000>;
	};
};
```

## src/main.c
```c
/*
 * Copyright (c) 2026 Mecha Systems
 *
 * SPDX-License-Identifier: BSD-3-Clause
 */

#include <errno.h>

#include <zephyr/app_version.h>
#include <zephyr/kernel.h>
#include <zephyr/logging/log.h>

#include "gamepad/gamepad_input.h"
#include "gamepad/gamepad_state.h"
#include "hid/gamepad_hid.h"
#include "status_led/status_led.h"
#include "usb/gamepad_usb.h"

/* Time to wait after a report could not be sent, so errors do not flood the log. */
#define ERROR_RETRY_DELAY_MS 10

LOG_MODULE_REGISTER(comet_gamepad, CONFIG_COMET_GAMEPAD_LOG_LEVEL);

/* Given when the gamepad state changed or when the host became ready for reports. */
static K_SEM_DEFINE(report_sem, 0, 1);

int main(void)
{
	struct gamepad_state state;
	int ret;

	LOG_INF("Comet Gamepad firmware %s", APP_VERSION_STRING);

	ret = status_led_init();
	if (ret < 0) {
		LOG_WRN("Running without the status LED (%d)", ret);
	}

	ret = gamepad_input_init(&report_sem);
	if (ret < 0) {
		return ret;
	}

	ret = gamepad_hid_init(&report_sem);
	if (ret < 0) {
		return ret;
	}

	ret = gamepad_usb_init();
	if (ret < 0) {
		return ret;
	}

	while (true) {
		k_sem_take(&report_sem, K_FOREVER);

		gamepad_input_get_state(&state);

		/*
		 * This waits until the host has read the report, so the USB polling interval
		 * already limits the report rate. Changes that happen while it waits are merged
		 * into the next report.
		 */
		ret = gamepad_hid_submit(&state);
		if (ret < 0 && ret != -EAGAIN) {
			LOG_WRN("Failed to send the report (%d)", ret);

			/* Do not retry in a tight loop. */
			k_msleep(ERROR_RETRY_DELAY_MS);
		}
	}

	return 0;
}
```
