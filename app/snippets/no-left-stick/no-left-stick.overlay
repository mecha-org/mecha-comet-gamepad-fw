/*
 * Copyright (c) 2026 Mecha Systems
 *
 * SPDX-License-Identifier: BSD-3-Clause
 */

/* For a gamepad without the left stick board connected. */

&left_stick {
	status = "disabled";
};

&adc0 {
	status = "disabled";
};
