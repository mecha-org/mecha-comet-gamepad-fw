/*
 * Copyright (c) 2026 Mecha Systems
 *
 * SPDX-License-Identifier: BSD-3-Clause
 */

/* For a gamepad without the Pivot Pip board connected. */

&pivot_pip {
	status = "disabled";
};

&ads1115 {
	status = "disabled";
};

&i2c0 {
	status = "disabled";
};
